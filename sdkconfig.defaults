## sdkconfig.defaults
```kconfig
CONFIG_SPIRAM=y
CONFIG_SPIRAM_MODE_OCT=y
CONFIG_SPIRAM_SPEED_80M=y
CONFIG_ESPTOOLPY_FLASHSIZE_8MB=y
CONFIG_ESP_CONSOLE_USB_SERIAL_JTAG=y
CONFIG_IT8951_SPI_HOST=2
CONFIG_IT8951_SCLK_PIN=12
CONFIG_IT8951_MOSI_PIN=11
CONFIG_IT8951_MISO_PIN=13
CONFIG_IT8951_CS_PIN=10
CONFIG_IT8951_RESET_PIN=9
CONFIG_IT8951_DISPLAY_READY_PIN=8
```
